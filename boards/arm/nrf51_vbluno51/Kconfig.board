## boards/arm/nrf51_vbluno51/Kconfig.board
```kconfig
# Kconfig - nRF51-VBLUNO51 board configuration
#
# Copyright (c) 2017 VNG IoT Lab Limited.
#
# SPDX-License-Identifier: Apache-2.0

config BOARD_NRF51_VBLUNO51
	bool "nRF51 VBLUno51 BLE"
	select HAS_DTS_I2C
	depends on SOC_NRF51822_QFAC
```

## boards/arm/nrf52_pca20020/Kconfig
```kconfig
# Kconfig - nRF52 PCA20020 board configuration
#
# Copyright (c) 2016 Nordic Semiconductor ASA
# Copyright (c) 2018 Aapo Vienamo
#
# SPDX-License-Identifier: Apache-2.0

if BOARD_NRF52_PCA20020

config  GPIO_AS_PINRESET
	bool "GPIO as pin reset (reset button)"
	default n

endif # BOARD_NRF52_PCA20020
```

## boards/arm/nrf52_pca20020/Kconfig.board
```kconfig
# Kconfig - nRF52 PCA20020 board configuration
#
# Copyright (c) 2016 Nordic Semiconductor ASA
# Copyright (c) 2018 Aapo Vienamo
#
# SPDX-License-Identifier: Apache-2.0

config  BOARD_NRF52_PCA20020
	bool "nRF52 PCA20020"
	depends on SOC_NRF52832_QFAA
```

## boards/arm/nrf52_pca20020/Kconfig.defconfig
```kconfig
# Kconfig - nRF52 PCA20020 board configuration
#
# Copyright (c) 2016 Nordic Semiconductor ASA
# Copyright (c) 2018 Aapo Vienamo
#
# SPDX-License-Identifier: Apache-2.0

if BOARD_NRF52_PCA20020

config BOARD
	default nrf52_pca20020

if GPIO_NRF5

config GPIO_NRF5_P0
	default y

endif # GPIO_NRF5

if UART_NRF5

config UART_NRF5_GPIO_TX_PIN
	default 3

config UART_NRF5_GPIO_RX_PIN
	default 2

endif # UART_NRF5

endif # BOARD_NRF52_PCA20020
```

## drivers/i2c/Kconfig.nrf5
```kconfig
# Kconfig.nrf5 - NRF5 I2C configuration options
#
#
# Copyright (c) 2018 Aapo Vienamo
#
# SPDX-License-Identifier: Apache-2.0
#


config I2C_NRF5
	bool "NRF5 I2C driver"
	depends on SOC_FAMILY_NRF5
	select GPIO
	default n
	help
	  This option enables the I2C driver for Nordic Semiconductor nRF5
	  family processors.

if I2C_NRF5

if I2C_0

config I2C_NRF5_0_GPIO_SCA_PIN
	int "Port 0 SCA Pin Number"
	range 0 31
	depends on I2C_NRF5
	help
	  The GPIO pin to use for SCA.

config I2C_NRF5_0_GPIO_SCL_PIN
	int "Port 0 SCL Pin Number"
	range 0 31
	depends on I2C_NRF5
	help
	  The GPIO pin to use for SCL.

endif # I2C_0

if I2C_1

config I2C_NRF5_1_GPIO_SCA_PIN
	int "Port 1 SCA Pin Number"
	range 0 31
	depends on I2C_NRF5
	help
	  The GPIO pin to use for SCA.

config I2C_NRF5_1_GPIO_SCL_PIN
	int "Port 1 SCL Pin Number"
	range 0 31
	depends on I2C_NRF5
	help
	  The GPIO pin to use for SCL.

endif # I2C_1

endif # I2C_NRF5
```

## dts/bindings/i2c/nordic,nrf5-i2c.yaml
```yaml
#
# Copyright (c) 2018 Aapo Vienamo
#
# SPDX-License-Identifier: Apache-2.0
#
---
title: Atmel SAM Family I2C (TWIHS) node
id: nordic,nrf5-i2c
version: 0.1

description: >
    This is a representation of the Nordic nRF5 I2C node

inherits:
    !include i2c.yaml

properties:
    compatible:
      type: string
      category: required
      description: compatible strings
      constraint: "nordic,nrf5-i2c"

    reg:
      type: array
      description: mmio register space
      generation: define
      category: required

    interrupts:
      type: array
      category: required
      description: required interrupts
      generation: define

    default_cfg:
      type: int
      category: optional
      description: default configuration
      generation: define

...
```
